## test_wake_net/esp_idf_code/sdkconfig.defaults
```kconfig
# Target + PSRAM (recommended)
CONFIG_IDF_TARGET="esp32s3"
CONFIG_ESPTOOLPY_FLASHMODE_QIO=y
CONFIG_SPIRAM=y
CONFIG_SPIRAM_USE_CAPS_ALLOC=y
CONFIG_ESP_SYSTEM_MEMPROT_FEATURE=n

# Logging
CONFIG_LOG_DEFAULT_LEVEL_INFO=y

# Wi-Fi
CONFIG_ESP_WIFI_STA_DISCONNECTED_PM_ENABLE=n

# WebSocket client (default is fine)

# ESP-SR: we’ll set these in menuconfig, but ensure AFE is enabled
# In menuconfig: Component config -> ESP Speech Recognition:
#   - Enable AFE
#   - Enable VAD
#   - Disable WakeNet
```
